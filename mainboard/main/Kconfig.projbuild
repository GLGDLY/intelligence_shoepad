## mainboard/main/Kconfig.projbuild
```kconfig
menu "Configuration"

    config BROKER_URL
        string "Broker URL"
        default "mqtt://mqtt.eclipseprojects.io"
        help
            URL of the broker to connect to

    config BROKER_URL_FROM_STDIN
        bool
        default y if BROKER_URL = "FROM_STDIN"

    config FREERTOS_CHECK_STACKOVERFLOW_PTRVAL
        bool
        default y
        help
            Check for stack overflow by writing a known value to the top of the stack
            of each task. This is the default behavior.
    
endmenu
```
